## app/boards/longan/canbed_m4/Kconfig.canbed_m4
```kconfig
# Copyright (c) 2026
# SPDX-License-Identifier: Apache-2.0

config BOARD_CANBED_M4
	select SOC_SAME51G19A
```

## app/boards/longan/canbed_m4/board.yml
```yaml
board:
  name: canbed_m4
  full_name: CANBed M4
  vendor: longan
  socs:
    - name: same51g19a
```
